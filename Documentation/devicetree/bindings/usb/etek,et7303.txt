## Documentation/devicetree/bindings/usb/etek,et7303.txt
```
Hynetek Husb311 Type-C Port controllers DT bindings

Required properties:
- compatible:       etek,et7303

- reg:              the i2c slave address of typec port controller device.
- interrupt-parent: the phandle to the interrupt controller which provides
                    the interrupt.
- interrupts:       interrupt specification for tcpci alert.

- pinctl-names : A pinctrl state named "default" must be defined
See: Documentation/devicetree/bindings/pinctrl/pinctrl-bindings.txt

- pinctrl-0    : Pin control group
See: Documentation/devicetree/bindings/pinctrl/pinctrl-bindings.txt

- vbus-supply:      vbus regulator

Required sub-node:
- connector: The "usb-c-connector" attached to the tcpci chip, the bindings
  of connector node are specified in
  Documentation/devicetree/bindings/connector/usb-connector.txt

Example:

#include "dt-bindings/usb/pd.h"

usbc0: et7303@4e {
	compatible = "etek,et7303";
	reg = <0x4e>;
	interrupt-parent = <&gpio1>;
	interrupts = <2 IRQ_TYPE_LEVEL_LOW>;
	pinctrl-names = "default";
	pinctrl-0 = <&et7303_int>;
	vbus-supply = <&vcc5v0_typec>;
	status = "okay";

	usb_con: connector {
		data-role = "dual";
		power-role = "dual";
		try-power-role = "sink";
		source-pdos = <PDO_FIXED(5000, 2000, PDO_FIXED_USB_COMM)>;
		sink-pdos = <PDO_FIXED(5000, 2000, PDO_FIXED_USB_COMM)>;
		op-sink-microwatt = <10000000>;

	};
};
```

## drivers/gpu/drm/rockchip/ht_eink/Kconfig
```kconfig
config HTFY_EBC
	bool "Htfyun Ebc support"
	depends on DRM_ROCKCHIP
	help
	  The EBC for Htfyun.

config PMIC_EBC_TPS65185
	bool "Htfyun Ebc pmic tps65185 support"
	help
	  The EBC PMIC TPS65185 for Htfyun.

config PMIC_EBC_SY7636A
	bool "Htfyun Ebc pmic sy7636a support"
	help
	  The EBC PMIC SY7636A for Htfyun.

config HTFY_DUMP
	bool "Htfyun dump kernel-buffer support"
	depends on HTFY_EBC
	default no
	help
	  dump kernel buffer by /dev/htdump_ctrl and /dev/htdump_data.

config HTFY_DEBUG
	bool "Htfyun debug prink-log support"
	depends on HTFY_EBC
	default yes
	help
	  config the run-time debug-prink on demand.
```

## drivers/hid/i2c-hid/Kconfig
```kconfig
menu "I2C HID support"
    depends on I2C

config I2C_HID
    tristate "HID over I2C transport layer"
    default n
    depends on I2C && INPUT
    select HID
    ---help---
      Say Y here if you use a keyboard, a touchpad, a touchscreen, or any
      other HID based devices which is connected to your computer via I2C.

      If unsure, say N.

      This support is also available as a module.  If so, the module
      will be called i2c-hid.

config I2C_HID_WACOM_9013
    tristate "HID over I2C transport layer OF WACOM 9013"
    default n
    depends on I2C && INPUT
    select HID
    ---help---
      Say Y here if you use WACOM 9013 PENCIL HID devices which is connected to your computer via I2C.

      If unsure, say N.

config I2C_HID_WACOM_10S12MI
    tristate "HID over I2C transport layer OF WACOM 10S12MI"
    default n
    depends on I2C && INPUT
    select HID
    ---help---
      Say Y here if you use WACOM 10S12MI PENCIL HID devices which is connected to your computer via I2C.

      If unsure, say N.

config I2C_HID_WACOM_HT
    tristate "HID over I2C transport layer OF WACOM"
    default n
    depends on I2C && INPUT
    select HID
    ---help---
      Say Y here if you use WACOM 10S12MI PENCIL HID devices which is connected to your computer via I2C.

      If unsure, say N.

endmenu
```

## drivers/input/fingerprint/Kconfig
```kconfig
menuconfig INPUT_FINGERPRINT
	bool "Fingerprint"
	help
	  Say Y here, and a list of supported Fingerprint will be displayed.

	  If unsure, say Y.

if INPUT_FINGERPRINT

source "drivers/input/fingerprint/ft9366/Kconfig"
endif
```

## drivers/input/touchscreen/gtx8/Kconfig
```kconfig
#
# Goodix touchscreen driver configuration
#
config TOUCHSCREEN_GOODIX_GTX8
	tristate "Goodix GTx8 touchscreen"
	depends on I2C
	help
	  Say Y here if you have a Goodix GTx8 touch controller
	  to your system.

	  If build module, say M.
	  If unsure, say N.
```

## drivers/input/touchscreen/huiontablet/Kconfig
```kconfig
#
# Huion driver configuration
#
config TOUCHSCREEN_HUION_PANELS
	tristate "Huion touchscreen pen"
	depends on I2C
	help
	  Say Y here if you have a huion touch pen controller
	  to your system.

	  If build module, say M.
	  If unsure, say N.
```

## drivers/input/touchscreen/ptxx/Kconfig
```kconfig
config TOUCHSCREEN_PARADE_LOADER
	tristate "Parade TrueTouch Gen5 MultiTouch Loader"
	depends on TOUCHSCREEN_PARADE
	help
	  Say Y here to enable Parade TrueTouch(tm) Standard Product
	  Generation5 touchscreen controller FW Loader module.

	  This module enables support for Firmware upgrade.

	  If unsure, say Y.

	  To compile this driver as a module, choose M here: the
	  module will be called pt_loader.

config TOUCHSCREEN_PARADE_PLATFORM_FW_UPGRADE
	bool "FW upgrade from header file"
	depends on TOUCHSCREEN_PARADE_LOADER
	help
	  Say Y here to include Parade TrueTouch(tm) Standard Product
	  Generation5 device Firmware into driver.

	  Need proper header file for this.

	  If unsure, say N.

config TOUCHSCREEN_PARADE_BINARY_FW_UPGRADE
	bool "FW upgrade from binary file"
	depends on TOUCHSCREEN_PARADE_LOADER
	help
	  Say Y here to include Parade TrueTouch(tm) Standard Product
	  Generation5 device Firmware into kernel as binary blob.

	  This should be enabled for manual FW upgrade support.

	  If unsure, say Y.

config TOUCHSCREEN_PARADE_PLATFORM_TTCONFIG_UPGRADE
	bool "TT Configuration upgrade from header file"
	depends on TOUCHSCREEN_PARADE_LOADER
	help
	  Say Y here to include Parade TrueTouch(tm) Standard Product
	  Generation5 device TrueTouch Configuration into kernel itself.

	  Need proper header file for this.

	  If unsure, say N.

config TOUCHSCREEN_PARADE_MANUAL_TTCONFIG_UPGRADE
	bool "TT Configuration upgrade via SysFs"
	depends on TOUCHSCREEN_PARADE_LOADER
	help
	  Say Y here to provide a SysFs interface to upgrade TrueTouch
	  Configuration with a binary configuration file.

	  Need proper binary version of config file for this
	  feature.

	  If unsure, say Y.

config TOUCHSCREEN_PARADE_DEBUG_MDL
	tristate "Parade TrueTouch Gen5 MultiTouch Debug Module"
	depends on TOUCHSCREEN_PARADE
	help
	  Say Y here to enable Parade TrueTouch(tm) Standard Product
	  Generation5 Debug module.

	  This module adds support for verbose printing touch
	  information.

	  If unsure, say N.

	  To compile this driver as a module, choose M here: the
	  module will be called pt_debug.
```

## drivers/net/wireless/rockchip_wlan/seekwave/Kconfig
```kconfig
config WLAN_VENDOR_SEEKWAVE
	tristate "Seekwave chipset 802.11ax support"
	depends on CFG80211
	help
	This module adds support for SeekWave 802.11ax wireless adapter chipset.

	If you have a wireless card belonging to this class, say Y.

	Note that the answer to this question doesn't directly affect the
	kernel: saying N will just cause the configurator to skip all the
	questions about these cards. If you say Y, you will be asked for
	your specific card in the following questions.
```
